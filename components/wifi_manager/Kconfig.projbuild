## components/wifi_manager/Kconfig.projbuild
```kconfig
menu "Wifi Manager Configuration"

config USE_BOTH_MDNS_HOSTNAME_AND_IP_IN_STA_AP
    bool "Enable mDNS for custom hostname as address"
    default n
    help
        Enable mDNS service, so that the wifi station can be accessed by both mDNS hostname and actual IP address. 
        This setting affect both Wifi SoftAP and Station mode.

    config MDNS_HOSTNAME
        string "mDNS Hostname"
        depends on USE_BOTH_MDNS_HOSTNAME_AND_IP_IN_STA_AP
        default "esp32-mdns" 
        help
            mDNS Hostname to use (max 50 characters), accept "a-z", "A-Z", "0-9", "-" and "_" (case insensitive). The resulting http address is `[MDNS_HOSTNAME].local`

    config MDNS_INSTANCE
        string "mDNS Instance Name"
        depends on USE_BOTH_MDNS_HOSTNAME_AND_IP_IN_STA_AP
        default "ESP32 with mDNS"
        help
            mDNS Instance Name for example to use

    config MDNS_ADD_MAC_TO_HOSTNAME
        bool "Add mac suffix to hostname"
        depends on USE_BOTH_MDNS_HOSTNAME_AND_IP_IN_STA_AP
        default n
        help
            If enabled, a portion of MAC address is added to the hostname, user can use this to differentiate multiple devices with same hostname.
            e.g. the host name may like `[MDNS_HOSTNAME]-3a1b2c`

config WIFI_MANAGER_TASK_PRIORITY
    int "RTOS Task Priority for the wifi_manager"
    default 5
    help
	Tasks spawn by the manager will have a priority of WIFI_MANAGER_TASK_PRIORITY-1. For this particular reason, minimum recommended task priority is 2.

config WIFI_MANAGER_RETRY_TIMER
	int "Time (in ms) between each retry attempt"
	default 5000
	help
	Defines the time to wait before an attempt to re-connect to a saved wifi is made after connection is lost or another unsuccesful attempt is made.

config WIFI_MANAGER_MAX_RETRY_START_AP
	int "Max Retry before starting the AP"
    default 3
    help
	Defines the maximum number of failed retries allowed before the WiFi manager starts its own access point.  
	
config WIFI_MANAGER_SHUTDOWN_AP_TIMER
	int "Time (in ms) to wait before shutting down the AP"
	default 60000
	help
	Defines the time (in ms) to wait after a succesful connection before shutting down the access point.

config WEBAPP_LOCATION
    string "Defines the URL where the wifi manager is located"
    default "/"
    help
    This parameter helps you relocate the wifimanager to another URL, for instance /wifimanager/ The trailing slash is important and should be included

config DEFAULT_AP_SSID
    string "Access Point SSID"
    default "esp32"
    help
	SSID (network name) the the esp32 will broadcast.

config DEFAULT_AP_PASSWORD
    string "Access Point Password"
    default "esp32pwd"
    help
	Password used for the Access Point. Leave empty and set AUTH MODE to WIFI_AUTH_OPEN for no password.

config DEFAULT_AP_CHANNEL
    int "Access Point WiFi Channel"
    default 1
    help
	Be careful you might not see the access point if you use a channel not allowed in your country.

config DEFAULT_AP_IP
    string "Access Point IP Address"
    default "10.10.0.1"
    help
	This is used for the redirection to the captive portal. It is recommended to leave unchanged.

config DEFAULT_AP_GATEWAY
    string "Access Point IP Gateway"
    default "10.10.0.1"
    help
	This is used for the redirection to the captive portal. It is recommended to leave unchanged.

config DEFAULT_AP_NETMASK
    string "Access Point Netmask"
    default "255.255.255.0"
    help
	This is used for the redirection to the captive portal. It is recommended to leave unchanged.

config DEFAULT_AP_MAX_CONNECTIONS
    int "Access Point Max Connections"
    default 4
    help
	Max is 4.

config DEFAULT_AP_BEACON_INTERVAL
    int "Access Point Beacon Interval (ms)"
    default 100
    help
	100ms is the recommended default.

endmenu
```
